list p=16F877A
#include <P16F877A.inc>
__config H'3F31'
Tmr0Sayaci EQU 0x25
	ORG 0X000
	GOTO ANA_PROGRAM
	ORG 0X004
KESME
	BTFSS INTCON,5
	GOTO KESME_BITIR
	BTFSS INTCON,TMR0IF
	GOTO SAY
	MOVLW d'6'
	MOVWF TMR0
	BCF INTCON,TMR0IF
	INCF Tmr0Sayaci,F	
	MOVLW D'250'
	SUBWF Tmr0Sayaci,W
	BTFSS STATUS,C
	GOTO KESME_BITIR
	CLRF Tmr0Sayaci
	movlw D'9'
	subwf PORTB,W
	BTFSS STATUS,C
	GOTO SAY
	CLRF PORTB
	GOTO KESME_BITIR
SAY
	INCF PORTB
KESME_BITIR
	RETFIE
ILK_ISLEMLER
	CLRF Tmr0Sayaci
	MOVLW 0XD3
	BSF STATUS,RP0
	MOVWF OPTION_REG
	CLRF TRISB
	BCF STATUS,RP0
	clrf PORTB
	MOVLW D'6'
	MOVWF TMR0
	BSF INTCON,D'5'
	BSF INTCON,D'7'
	RETURN
ANA_PROGRAM
	CALL ILK_ISLEMLER
ANA_PRO
	GOTO ANA_PRO
END
	
