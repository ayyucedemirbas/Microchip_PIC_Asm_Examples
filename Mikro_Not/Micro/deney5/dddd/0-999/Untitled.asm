list p=16F877A
#include <P16F877A.inc>
__config H'3F31'
SAYAC1 EQU 0X20
SAYAC2 EQU 0X25
SAYAC3 EQU 0X30
SAYAC4 EQU 0X35
DISPLAY1 EQU 0X36
DISPLAY2 EQU 0X37
DISPLAY3 EQU 0X38
DISPLAY4 EQU 0X39
KONTROL EQU 0X40
ORG 0X00
GOTO ANA_PROGRAM 
ORG 0X004; 
KESME;---------------------------------
BTFSS PIR1,1
GOTO KESME_SONLANDIR
BCF PIR1,1
INCF KONTROL,F
MOVLW D'100'
SUBWF KONTROL,W
BTFSS STATUS,Z
GOTO KESME_SONLANDIR
CLRF KONTROL

MOVLW D'10'
INCF SAYAC1,F
SUBWF SAYAC1,W
BTFSS STATUS,Z
GOTO DEGER_AL
CLRF SAYAC1
MOVLW D'10'
INCF SAYAC2,F
SUBWF SAYAC2,W
BTFSS STATUS,Z
GOTO DEGER_AL
CLRF SAYAC2
MOVLW D'10'
INCF SAYAC3,F
SUBWF SAYAC3,W
BTFSS STATUS,Z
GOTO DEGER_AL
CLRF SAYAC3
MOVLW D'10'
INCF SAYAC4,F
SUBWF SAYAC4,W
BTFSS STATUS,Z
GOTO DEGER_AL
GOTO ANA_PROGRAM
DEGER_AL
MOVF SAYAC1,W
CALL TABLO
MOVWF DISPLAY1

MOVF SAYAC2,W
CALL TABLO
MOVWF DISPLAY2

MOVF SAYAC3,W
CALL TABLO
MOVWF DISPLAY3

MOVF SAYAC4,W
CALL TABLO
MOVWF DISPLAY4

RETFIE

TABLO

ADDWF PCL,F
RETLW B'00111111'
RETLW B'00110000'
RETLW B'01011011'
RETLW B'01001111'
RETLW B'01100110'
RETLW B'01101101'
RETLW B'01111101'
RETLW B'00000111'
RETLW B'01111111'
RETLW B'01101111'

RETURN

KESME_SONLANDIR
RETFIE


 ANA_PROGRAM;-------------
CLRF SAYAC1
CLRF SAYAC2
CLRF SAYAC3
CLRF SAYAC4
CLRF KONTROL
MOVLW B'11000000'
MOVWF INTCON

BSF STATUS,RP0; Bank-1'e geç
CLRF TRISD
CLRF TRISA
BSF PIE1,TMR2IE
MOVLW D'249'
MOVWF PR2

BCF STATUS,RP0;Bank-0'a gecis
MOVLW B'00000110'
MOVWF T2CON
MOVLW B'111111'
MOVWF PORTA
CLRF PORTD


 DONGU 

MOVLW B'000000'
MOVWF PORTA
MOVF DISPLAY1,W
MOVWF PORTD

MOVLW B'000001'
MOVWF PORTA
MOVF DISPLAY1,W
MOVWF PORTD


MOVLW B'000000'
MOVWF PORTA
MOVF DISPLAY2,W
MOVWF PORTD

MOVLW B'000010'
MOVWF PORTA
MOVF DISPLAY2,W
MOVWF PORTD

MOVLW B'000000'
MOVWF PORTA
MOVF DISPLAY3,W
MOVWF PORTD

MOVLW B'000100'
MOVWF PORTA
MOVF DISPLAY3,W
MOVWF PORTD

MOVLW B'000000'
MOVWF PORTA
MOVF DISPLAY4,W
MOVWF PORTD

MOVLW B'001000'
MOVWF PORTA
MOVF DISPLAY4,W
MOVWF PORTD

 GOTO DONGU



END
 