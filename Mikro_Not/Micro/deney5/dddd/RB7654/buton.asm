list p=16f877A
#include "p16f877A.inc"
SAYAC1 EQU 0X20
SAYAC2 EQU 0X21
SAYAC3 EQU 0X22
SAYAC4 EQU 0X23
DISPLAY1 EQU 0X24
DISPLAY2 EQU 0X25
DISPLAY3 EQU 0X26
DISPLAY4 EQU 0X27
ORG 0X00
GOTO ANA_PROGRAM
ORG 0X04
KESME

BTFSS INTCON,0
GOTO KESME_BITIR
BCF INTCON,0
BTFSC PORTB,4
GOTO BIRLER
BTFSC PORTB,5
GOTO ONLAR
BTFSC PORTB,6
GOTO YUZLER
BTFSC PORTB,7
GOTO BINLER
GOTO KESME_BITIR

BIRLER
BCF INTCON,0
INCF SAYAC1,W
CALL TABLO
MOVWF DISPLAY1
INCF SAYAC1,F
MOVLW D'11'
SUBWF SAYAC1,W
BTFSS STATUS,Z
GOTO KESME_BITIR
CLRF SAYAC1
GOTO BIRLER

ONLAR 

BCF INTCON,0

INCF SAYAC2,W
CALL TABLO
MOVWF DISPLAY2
INCF SAYAC2,F
MOVLW D'11'
SUBWF SAYAC2,W
BTFSS STATUS,Z
GOTO KESME_BITIR
CLRF SAYAC2 
GOTO ONLAR

YUZLER
BCF INTCON,0

INCF SAYAC3,W
CALL TABLO
MOVWF DISPLAY3
INCF SAYAC3,F
MOVLW D'11'
SUBWF SAYAC3,W
BTFSS STATUS,Z
GOTO KESME_BITIR
CLRF SAYAC3
GOTO YUZLER

BINLER
BCF INTCON,0

INCF SAYAC4,W
CALL TABLO
MOVWF DISPLAY4
INCF SAYAC4,F
MOVLW D'11'
SUBWF SAYAC4,W
BTFSS STATUS,Z
GOTO KESME_BITIR
CLRF SAYAC4
GOTO BINLER

TABLO
ADDWF PCL,F
RETLW B'00111111'
RETLW B'00111111'
RETLW B'00000110'
RETLW B'01011011'
RETLW B'01001111'
RETLW B'01100110'
RETLW B'01101101'
RETLW B'011111101'
RETLW B'00000111'
RETLW B'01111111'
RETLW B'01101111'
RETLW B'01101111'

KESME_BITIR
BCF INTCON,0
RETFIE

ANA_PROGRAM
BSF STATUS,RP0
MOVLW B'11001000'
MOVWF INTCON
BSF OPTION_REG,7 ;PULL-UP DÝRENÇLERÝ AKTÝF
CLRF TRISD
CLRF TRISA
MOVLW B'11110000'
MOVWF TRISB

BCF STATUS,RP0

MOVLW H'FF'
MOVWF PORTD
MOVLW B'000000'
MOVWF PORTA
CLRF PORTB
CLRF SAYAC1
CLRF SAYAC2
CLRF SAYAC3
CLRF SAYAC4
CLRF DISPLAY1
CLRF DISPLAY2
CLRF DISPLAY3
CLRF DISPLAY4

DONGU1 

MOVLW B'000001'
MOVWF PORTA
MOVF DISPLAY1,W
MOVWF PORTD



MOVLW B'000000'
MOVWF PORTA
MOVF DISPLAY4,W
MOVWF PORTD

MOVLW B'001000'
MOVWF PORTA
MOVF DISPLAY4,W
MOVWF PORTD

MOVLW B'000000'
MOVWF PORTA
MOVF DISPLAY3,W
MOVWF PORTD


MOVLW B'000100'
MOVWF PORTA
MOVF DISPLAY3,W
MOVWF PORTD

MOVLW B'000000'
MOVWF PORTA
MOVF DISPLAY4,W
MOVWF PORTD

MOVLW B'000010'
MOVWF PORTA
MOVF DISPLAY2,W
MOVWF PORTD

MOVLW B'000000'
MOVWF PORTA

GOTO DONGU1


END