list p=16f877A
#include "p16f877A.inc"
SAYAC1 EQU 0X20
SAYAC2 EQU 0X21
SAYAC3 EQU 0X22
SAYAC4 EQU 0X23
ORG 0X00
GOTO ANA_PROGRAM
ORG 0X04
KESME

BTFSS INTCON,0
GOTO KESME_BITIR
BCF INTCON,0
BTFSC PORTB,4
GOTO BIRLER
BTFSC PORTB,5
GOTO ONLAR
BTFSC PORTB,6
GOTO YUZLER
BTFSC PORTB,7
GOTO BINLER
GOTO KESME_BITIR

BIRLER
MOVLW B'000111'
MOVWF PORTA
INCF SAYAC1,W
CALL TABLO
MOVWF PORTD
INCF SAYAC1,F
MOVLW D'11'
SUBWF SAYAC1,W
BTFSS STATUS,Z
GOTO KESME_BITIR
CLRF SAYAC1
GOTO BIRLER

ONLAR 
MOVLW B'001011'
MOVWF PORTA
INCF SAYAC2,W
CALL TABLO
MOVWF PORTD
INCF SAYAC2,F
MOVLW D'11'
SUBWF SAYAC2,W
BTFSS STATUS,Z
GOTO KESME_BITIR
CLRF SAYAC2 
GOTO ONLAR

YUZLER
MOVLW B'001101'
MOVWF PORTA
INCF SAYAC3,W
CALL TABLO
MOVWF PORTD
INCF SAYAC3,F
MOVLW D'11'
SUBWF SAYAC3,W
BTFSS STATUS,Z
GOTO KESME_BITIR
CLRF SAYAC3
GOTO YUZLER

BINLER
MOVLW B'001110'
MOVWF PORTA
INCF SAYAC4,W
CALL TABLO
MOVWF PORTD
INCF SAYAC4,F
MOVLW D'11'
SUBWF SAYAC4,W
BTFSS STATUS,Z
GOTO KESME_BITIR
CLRF SAYAC4
GOTO BINLER

TABLO
ADDWF PCL,F
RETLW B'00111111'
RETLW B'001111111'
RETLW B'00000110'
RETLW B'01101101'
RETLW B'01111001'
RETLW B'00110011'
RETLW B'01011011'
RETLW B'01011111'
RETLW B'01110000'
RETLW B'01111111'
RETLW B'01111011'
RETLW B'01111011'

KESME_BITIR
RETFIE

ANA_PROGRAM
BSF STATUS,RP0
MOVLW B'11001000'
MOVWF INTCON
BCF OPTION_REG,7 ;PULL-UP DÝRENÇLERÝ AKTÝF
CLRF TRISD
CLRF TRISA
MOVLW B'11110000'
MOVWF PORTB
BCF STATUS,RP0
MOVLW H'FF'
MOVWF PORTD
MOVLW B'001111'
MOVWF PORTA
CLRF SAYAC1
CLRF SAYAC2
CLRF SAYAC3
CLRF SAYAC4

DONGU 

GOTO DONGU


END