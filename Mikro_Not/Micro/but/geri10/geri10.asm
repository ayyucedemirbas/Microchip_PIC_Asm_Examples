list p=16f877a
include "p16f877a.inc"
SAYAC EQU 0x23
SAYAC1 EQU 0x24
SAYAC2 EQU 0x25
org 0
GOTO ANA
ORG 4
KESME 
RETFIE
TABLO 
ADDWF PCL,F
RETLW H'3F'
RETLW H'06'
RETLW H'5B'
RETLW H'4F'
RETLW H'66'
RETLW H'6D'
RETLW H'7D'
RETLW H'07'
RETLW H'7F'
RETLW H'6F'


ANA
BANKSEL TRISA
CLRF TRISA
BANKSEL PORTA
CLRF PORTA
MOVLW H'01'
MOVWF PORTA
BANKSEL TRISD 
CLRF TRISD
BANKSEL PORTD
CLRF PORTD
BANKSEL SAYAC 
CLRF SAYAC
MOVLW D'9'
MOVWF SAYAC
DONGU 
BANKSEL PORTA
MOVLW H'01'
MOVWF PORTA
BANKSEL SAYAC 
MOVF SAYAC,W
CALL TABLO 
MOVWF PORTD
MOVWF PORTD
CALL GECIK
DECFSZ SAYAC,F
GOTO DONGU
BANKSEL SAYAC
MOVF SAYAC,W
CALL TABLO
MOVWF PORTD
CALL GECIK
BANKSEL SAYAC
MOVLW D'9'
MOVWF SAYAC
GOTO DONGU
GECIK 
MOVLW H'FF'
MOVWF SAYAC1
DON
MOVLW H'FF'
MOVWF SAYAC2
DON1
DECFSZ SAYAC2,F
GOTO DON1
DECFSZ SAYAC1,F
GOTO DON
RETURN 
END
