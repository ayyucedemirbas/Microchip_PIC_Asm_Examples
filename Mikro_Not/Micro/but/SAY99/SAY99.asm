list p=16f877a
include "p16f877a.inc"
SAYAC EQU 0x22
SAYAC1 EQU 0x23
SAYAC2 EQU 0X24
SAYAC3 EQU 0x25
org 0
GOTO ANA 
ORG 4
KESME
BTFSS INTCON,1
RETFIE
BCF INTCON,1
A
INCF SAYAC,F
XORLW D'10'
BTFSS STATUS,2
BANKSEL PORTA
MOVLW H'01'
MOVWF PORTA
MOVF SAYAC,W
 CALL TABLO 
MOVWF PORTD
CALL GECIK
GOTO A
CLRF SAYAC
BANKSEL PORTA
MOVLW H'01'
MOVWF PORTA
MOVF SAYAC,W
 CALL TABLO 
MOVWF PORTD
CALL GECIK
DISP
INCF SAYAC3,F
XORLW D'10'
BTFSS STATUS,2
BANKSEL PORTA
MOVLW H'02'
MOVWF PORTA
MOVF SAYAC3,W
 CALL TABLO 
MOVWF PORTD
CALL GECIK
GOTO A
CLRF SAYAC3
CLRF SAYAC
RETFIE


TABLO
ADDWF PCL,F
RETLW H'3F'
RETLW H'06'
RETLW H'5B'
RETLW H'4F'
RETLW H'66'
RETLW H'6D'
RETLW H'7D'
RETLW H'07'
RETLW H'7F'
RETLW H'6F'


ANA
BANKSEL TRISA 
CLRF TRISA
BANKSEL PORTA
MOVLW H'03'
MOVWF PORTA
BANKSEL TRISD
CLRF TRISD
BANKSEL PORTD
CLRF PORTD
BANKSEL TRISB
MOVLW H'FF'
MOVWF TRISB
BANKSEL PORTB 
CLRF PORTB
BANKSEL INTCON
MOVLW B'10010000'
MOVWF INTCON
BANKSEL OPTION_REG
CLRF OPTION_REG
BANKSEL SAYAC
CLRF SAYAC
CLRF SAYAC1
CLRF SAYAC2
CLRF SAYAC3
DONGU 

GOTO DONGU
GECIK
MOVLW H'FF'
MOVWF SAYAC1
DON

MOVLW H'FF'
MOVWF SAYAC2
DON1
DECFSZ SAYAC2,F
GOTO DON1
DECFSZ SAYAC1,F
GOTO DON
RETURN
END
