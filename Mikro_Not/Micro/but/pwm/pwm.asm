list p=16f877a
 include "p16f877a.inc"
 SAYAC EQU 0x23
ORG 0
 GOTO ANA
 ORG 4
  KESME
  BTFSS INTCON,0
RETFIE
BTFSC PORTB,4
GOTO BES
MOVF CCPR1L,W
XORLW H'64'
BTFSC STATUS ,2
GOTO SON
MOVF SAYAC ,W
ADDWF CCPR1L,F
GOTO SON
BES 
BTFSC PORTB,5
GOTO SON
MOVF CCPR1L,W
XORLW H'00'
BTFSC STATUS,2
GOTO SON
MOVF SAYAC,W
SUBWF CCPR1L,F
GOTO SON
SON
BCF INTCON,0
RETFIE








ANA
BANKSEL TRISC 
CLRF TRISC
 BANKSEL PORTC
CLRF PORTC
BANKSEL TRISB 
MOVLW H'FF'
MOVWF TRISB
BANKSEL PORTB 
CLRF PORTB
BANKSEL INTCON 
MOVLW B'11001000'
MOVWF INTCON
BANKSEL PIE1
BSF PIE1,1
BANKSEL T2CON
MOVLW B'00000101'
MOVWF T2CON
BANKSEL PR2
MOVLW D'99'
MOVWF PR2
BANKSEL CCP1CON
MOVLW B'00001100'
MOVWF CCP1CON
BANKSEL CCPR1L
MOVLW H'32'
MOVWF CCPR1L
BANKSEL SAYAC 
CLRF SAYAC
MOVLW H'05';20 NÝN 2 BÝTTÝ ATILMIÞ
MOVWF SAYAC
DONGU 
GOTO DONGU 
END
