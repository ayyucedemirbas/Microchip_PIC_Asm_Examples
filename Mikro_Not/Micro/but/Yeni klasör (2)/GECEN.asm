list p=16F877A
include "p16f877a.inc"
SAYAC1 EQU 0x23
SAYAC2 EQU 0x24
ORG 0
GOTO ANA
 ORG 4
 KESME 
BTFSS INTCON,0
RETFIE
BTFSC PORTB,4
GOTO BES
BANKSEL PORTA
MOVLW H'01'
MOVWF PORTA
BANKSEL PORTD 
MOVLW H'06'
MOVWF PORTD
MOVWF PORTD
CALL GECIK
GOTO SON
BES 
BTFSC PORTB,5
GOTO SON
BANKSEL PORTA
MOVLW H'02'
MOVWF PORTA
BANKSEL PORTD
MOVLW H'3F'
MOVWF PORTD
MOVWF PORTD
CALL GECIK

SON
BCF INTCON,0
RETFIE
GECIK
MOVLW H'FF'
MOVWF SAYAC1
DON

MOVLW H'FF'
MOVWF SAYAC2
DON1
DECFSZ SAYAC2,F
GOTO DON1
DECFSZ SAYAC1,F
GOTO DON
RETURN








ANA
BANKSEL TRISA
 CLRF TRISA
BANKSEL PORTA
MOVLW H'03'
MOVWF PORTA
 BANKSEL TRISD 
CLRF TRISD 
BANKSEL PORTD
 CLRF PORTD
BANKSEL TRISB
MOVLW H'F0'
MOVWF TRISB
BANKSEL PORTB 
CLRF PORTB
BANKSEL INTCON
MOVLW B'11001000'
MOVWF INTCON
DONGU
 GOTO DONGU
END