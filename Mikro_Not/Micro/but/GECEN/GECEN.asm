list p=16f877A
include "P16F877A.inc"
SAYAC1 EQU 0x23
SAYAC2 EQU 0x24
ORG 0
GOTO ANA
ORG 4 
KESME
BTFSS INTCON,0
GOTO SON
BTFSC PORTB,4
GOTO KONTROL
BANKSEL PORTA
MOVLW H'01'
MOVWF PORTA
MOVLW H'4F'
MOVWF PORTD
MOVWF PORTD
CALL GECIK
GOTO SON
KONTROL
BTFSC PORTB,5
GOTO SON
BANKSEL PORTA
MOVLW H'02'
MOVWF PORTA
MOVLW H'5B'
MOVWF PORTD
MOVWF PORTD
CALL GECIK
SON
BCF INTCON,0
RETFIE
GECIK
MOVLW H'FF'
MOVWF SAYAC1
DON

MOVLW H'FF'
MOVWF SAYAC2
DON1
DECFSZ SAYAC2,F
GOTO DON1
DECFSZ SAYAC1,F
GOTO DON

RETURN









ANA
BANKSEL TRISA 
CLRF TRISA 
BANKSEL TRISB
 MOVLW H'F0'
 MOVWF TRISB 
 BANKSEL PORTA
 MOVLW H'03'
 MOVWF PORTA
 BANKSEL TRISD 
 CLRF TRISD
 BANKSEL PORTD
 CLRF PORTD
BANKSEL INTCON 
MOVLW B'10001000'
MOVWF INTCON
BANKSEL OPTION_REG 
CLRF OPTION_REG
BANKSEL SAYAC1
CLRF SAYAC1
CLRF SAYAC2
DONGU
GOTO DONGU
END