list p=16f877a
include "p16f877a.inc"
SAYAC1 EQU 0x22
SAYAC2 EQU 0x23
SAY1 EQU 0x24
SAY2 EQU 0x25
SAY3 EQU 0x26
SAY4 EQU 0x27


org 0
goto ANA 
ORG 4
KESME
BTFSS INTCON,0
RETFIE
DORT 
BTFSC PORTB,4
GOTO BES
BANKSEL SAY1
INCF SAY1,F
MOVF SAY1,W
XORLW D'10'
BTFSS STATUS,2
GOTO SON
CLRF SAY1
GOTO SON
BES 
BTFSC PORTB,5
GOTO ALTI
BANKSEL SAY2
INCF SAY2,F
MOVF SAY2,W
XORLW D'10'
BTFSS STATUS,2
GOTO SON
CLRF SAY2
GOTO SON
ALTI
BTFSC PORTB,6
GOTO YEDI
BANKSEL SAY3
INCF SAY3,F
MOVF SAY3,W
XORLW D'10'
BTFSS STATUS,2
GOTO SON
CLRF SAY3
GOTO SON

YEDI
BTFSC PORTB,7
GOTO SON
BANKSEL SAY4
INCF SAY4,F
MOVF SAY4,W
XORLW D'10'
BTFSS STATUS,2
GOTO SON
CLRF SAY4
GOTO SON

SON
BCF INTCON,0
RETFIE
TABLO 
ADDWF PCL,F
RETLW H'3F'
RETLW H'06'
RETLW H'5B'
RETLW H'4F'
RETLW H'66'
RETLW H'6D'
RETLW H'7D'
RETLW H'07'
RETLW H'7F'
RETLW H'6F'
GECIK
MOVLW H'08'
MOVWF SAYAC1
DON

MOVLW H'08'
MOVWF SAYAC2
DON1
DECFSZ SAYAC2,F
GOTO DON1
DECFSZ SAYAC1,F
GOTO DON
RETURN







ANA 
BANKSEL TRISA
CLRF TRISA
BANKSEL PORTA
CLRF PORTA
MOVLW H'0F'
MOVWF PORTA
BANKSEL TRISD 
CLRF TRISD
BANKSEL PORTD
 CLRF PORTD
BANKSEL TRISB
MOVLW H'F0'
MOVWF TRISB
BANKSEL PORTB
CLRF PORTB
BANKSEL INTCON
MOVLW B'10001000'
MOVWF INTCON
BANKSEL SAY1
CLRF SAY1
CLRF SAY2
CLRF SAY3
CLRF SAY4
CLRF SAYAC1
CLRF SAYAC2
DONGU 
CALL GECIK
BANKSEL PORTA
MOVLW H'01'
MOVWF PORTA
BANKSEL SAY1
MOVF SAY1,W
CALL TABLO
MOVWF PORTD
CALL GECIK
BANKSEL PORTA
MOVLW H'02'
MOVWF PORTA
BANKSEL SAY2
MOVF SAY2,W
CALL TABLO
MOVWF PORTD
CALL GECIK
BANKSEL PORTA
MOVLW H'04'
MOVWF PORTA
BANKSEL SAY3
MOVF SAY3,W
CALL TABLO
MOVWF PORTD
CALL GECIK
BANKSEL PORTA
MOVLW H'08'
MOVWF PORTA
BANKSEL SAY4
MOVF SAY4,W
CALL TABLO
MOVWF PORTD




GOTO DONGU
END
