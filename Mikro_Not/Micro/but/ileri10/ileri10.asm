list p=16f877a
include "p16f877a.inc"
SAYAC EQU 0x23
SAYAC1 EQU 0x24
SAYAC2 EQU 0x25
ORG 0
GOTO ANA
ORG 4
KESME
RETFIE
TABLO
ADDWF PCL,F
RETLW H'3F'
RETLW H'06'
RETLW H'5B'
RETLW H'4F'
RETLW H'66'
RETLW H'6D'
RETLW H'7D'
RETLW H'07'
RETLW H'7F'
RETLW H'6F'


ANA
BANKSEL TRISA 
CLRF TRISA
BANKSEL PORTA
MOVLW H'01'
MOVWF PORTA
BANKSEL SAYAC 
CLRF SAYAC
BANKSEL TRISD 
CLRF TRISD
BANKSEL PORTD
CLRF PORTD
DONGU
BANKSEL PORTA
MOVLW H'01'
MOVWF PORTA
MOVF SAYAC,W
CALL TABLO
MOVWF PORTD
MOVWF PORTD
MOVWF PORTD
MOVWF PORTD
CALL GECIK
INCF SAYAC,F
XORLW D'10'
BTFSS STATUS,2
GOTO DONGU
CLRF SAYAC 
GOTO DONGU
GECIK
MOVLW H'FF'
MOVWF SAYAC1
DON
MOVLW H'FF'
MOVWF SAYAC2
DON1
DECFSZ SAYAC2,F
GOTO DON1
DECFSZ SAYAC1,F
GOTO DON
RETURN
END