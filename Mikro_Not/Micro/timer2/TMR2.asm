list p=16F877A
#include <P16F877A.inc>
__config H'3F31'
TEMP1 EQU 0X20;sayac1
TEMP2 EQU 0X21;sayac2 

ORG 0X00
GOTO ANA_PROGRAM 
ORG 0X004; 
KESME;---------------------------------
BCF STATUS,RP0
BTFSS PIR1,1
GOTO ATLA
BCF PIR1,1

GOTO KESME_BÝTÝR
ATLA;--------------------------
BTFSS INTCON,1
GOTO KESME_BÝTÝR
INCF TEMP2,F
BTFSS TEMP2,3
GOTO ÝSLEM
GOTO BÝTÝR
ÝSLEM;----------------
BCF INTCON,1
MOVLW D'12'
SUBWF TEMP1,F
MOVF TEMP1,W
MOVWF CCPR1L
GOTO KESME_BÝTÝR
BÝTÝR;-----------------
BCF INTCON,4
GOTO KESME_BÝTÝR


 
 KESME_BÝTÝR
 RETFIE



 ANA_PROGRAM;------------------------------ 
 BSF STATUS,RP0
 BCF TRISC,2
 BSF TRISB,0
 BCF OPTION_REG,7
 BSF OPTION_REG,6
 MOVLW B'11010000'
 MOVWF INTCON
 BSF PIE1,1
 MOVLW D'124'
 MOVWF PR2
 BCF STATUS,RP0
CLRF PORTC
 MOVLW B'00000101'
 MOVWF T2CON ;TMR2 AKTÝF ETME VE PRESCALER 
 MOVLW B'00101100'
 MOVWF CCP1CON
 MOVLW B'01110000'
 MOVWF CCPR1L
 MOVWF TEMP1
 
 
 DONGU 
 GOTO DONGU
END
 