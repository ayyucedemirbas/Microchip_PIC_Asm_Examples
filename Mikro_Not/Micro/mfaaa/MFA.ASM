LIST P=16F877A
#INCLUDE <P16F877A.INC>
__CONFIG H'3F31'
SAY EQU 0X020
SAY2 EQU 0X021
SAY3 EQU 0X022
ORG 0X000
GOTO ANA_PROG
ORG 0X004
KESME
BTFSS INTCON,2
GOTO BÝTÝR
BCF INTCON,2
DECFSZ SAY2
GOTO BÝTÝR
BTFSC SAY,0
GOTO SOLA
BTFSS SAY,0
GOTO SAGA
GOTO BÝTÝR
SOLA
BTFSS SAY3,0
GOTO BÝR
RLF PORTB
BTFSS PORTB,7
GOTO BÝTÝR
CLRF SAY
GOTO BÝTÝR
BÝR
INCF PORTB,F
BSF SAY3,0
GOTO BÝTÝR
SAGA
RRF PORTB
BTFSS PORTB,0
GOTO BÝTÝR
MOVLW D'1'
MOVWF SAY
BÝTÝR
MOVLW D'6'
MOVWF TMR0
BCF INTCON,2
  RETFIE
ANA_PROG
BSF STATUS,RP0
CLRF TRISB
MOVLW B'00000010'
MOVWF OPTION_REG
MOVLW B'10100000'
MOVWF INTCON
BCF STATUS,RP0
MOVLW D'0'
MOVWF PORTB
MOVLW D'6'
MOVWF TMR0
MOVLW D'1'
MOVWF SAY
MOVLW D'250'
MOVWF SAY2
CLRF SAY3
DONGU
	GOTO DONGU
END