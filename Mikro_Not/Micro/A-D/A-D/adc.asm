LIST P=16F877A
#INCLUDE <P16F877A.INC>
SAYAC1 EQU 0X20
SAYAC2 EQU 0X21
DEGERH EQU 0X22
DEGERL EQU 0X23
SAYI1  EQU 0X24
SAYI2  EQU 0X25
SAYI3  EQU 0X26
SAYI4  EQU 0X27
DEGER EQU 0X28
GSAYAC1 EQU 0X29
GSAYAC EQU 0X2A
ORG 0X00
GOTO ANA_PROGRAM
ORG 0X04
GOTO KESME

ANA_PROGRAM
BSF STATUS,RP0
MOVLW H'01'
MOVWF TRISA
CLRF TRISD
CLRF TRISC
BCF STATUS,RP0
MOVLW B'11110000'
MOVWF PORTA
CLRF PORTD
CLRF PORTC
CLRF SAYAC1
CLRF SAYAC2
CLRF GSAYAC
CLRF GSAYAC1
BSF STATUS,RP0
BSF PIE1,ADIE
BSF INTCON,7
BSF INTCON,6
MOVLW b'10001110'
MOVWF ADCON1
BCF STATUS,RP0
BCF PIR1,ADIF
MOVLW B'11000001'
MOVWF ADCON0
CALL GECIK
BSF ADCON0,2;GO-DONE PÝNÝNÝ SET ET A-D ÇEVÝRÝMÝNE BASLA
GOTO HEDEF

KESME
BTFSS PIR1,ADIF
GOTO KESME_BITIR
BCF PIR1,ADIF
BSF STATUS,RP0
MOVF ADRESL,W
BCF STATUS,RP0
MOVWF DEGERL
MOVF ADRESH,W
MOVWF DEGERH
MOVLW 	B'11000001'				;Kanal7 seçildi.
MOVWF 	ADCON0
CALL 	GECIK						;1ms ADC ' yi bekle	
BSF 	ADCON0,GO			;Çeviriyi baþlat.

GOTO KESME_BITIR

GECIK
MOVLW D'250'
MOVWF SAYAC1
DONGU
NOP
NOP
DECFSZ SAYAC1,F
GOTO DONGU
INCF SAYAC2,F
MOVLW D'250'
MOVWF SAYAC1
BTFSS SAYAC2,1
GOTO DONGU
CLRF SAYAC2
RETURN

KESME_BITIR
RETFIE

HEDEF
MOVF DEGERL,W
MOVWF DEGER
CALL HESAP
CALL HESAP2
CALL YAZ
GOTO HEDEF
YAZ
MOVLW D'250'
MOVWF GSAYAC
CALL GECIKDSP

MOVF SAYI4,W
CALL KODLA
BCF PORTA,1
MOVWF PORTD
BSF PORTA,1

MOVLW D'250'
MOVWF GSAYAC
CALL GECIKDSP

MOVF SAYI3,W
CALL KODLA
BCF PORTA,2
MOVWF PORTD
BSF PORTA,2

MOVLW D'250'
MOVWF GSAYAC
CALL GECIKDSP

MOVF SAYI2,W
CALL KODLA
BCF PORTA,3
MOVWF PORTD
BSF PORTA,3

RETURN
;HESAP1	
HESAP
	MOVLW .0
	MOVWF SAYI1
	MOVWF SAYI2
	MOVWF SAYI3
	MOVWF SAYI4
HES
	MOVLW .100
	SUBWF DEGER,W
	BTFSS STATUS,C
	GOTO HES1
	MOVLW .100
	SUBWF DEGER,F
	INCF SAYI2,F
	GOTO HES
HES1
	MOVLW .10
	SUBWF DEGER,W
	BTFSS STATUS,C
	GOTO HES2
	MOVLW .10
	SUBWF DEGER,F
	INCF SAYI3,F
	GOTO HES1
HES2
	MOVLW .1
	SUBWF DEGER,W
	BTFSS STATUS,C
	RETURN
	MOVLW .1
	SUBWF DEGER,F
	INCF SAYI4,F
	GOTO HES2
;HESAP2
HESAP2
	MOVLW .0
	SUBWF DEGERH,W
	BTFSC STATUS,Z
	RETURN
	BTFSC DEGERH,0
	GOTO YAZ256
DEVAM
	BTFSC DEGERH,1
	GOTO YAZ512
	RETURN
YAZ256
	MOVLW .2
	ADDWF SAYI2,F
	MOVLW .5
	ADDWF SAYI3,F
	MOVLW .6
	ADDWF SAYI4,F
	CALL SONUC
	GOTO DEVAM	
YAZ512
	MOVLW .5
	ADDWF SAYI2,F
	MOVLW .1
	ADDWF SAYI3,F
	MOVLW .2
	ADDWF SAYI4,F
	CALL SONUC
	RETURN
SONUC
	MOVLW .10
	SUBWF SAYI4,W
	BTFSC STATUS,C
	CALL BUYUK
	MOVLW .10
	SUBWF SAYI3,W
	BTFSC STATUS,C
	CALL BUYUK1
	MOVLW .10
	SUBWF SAYI2,W
	BTFSC STATUS,C
	CALL BUYUK2
	RETURN
BUYUK
	MOVWF SAYI4
	INCF SAYI3,F
	RETURN
BUYUK1
	MOVWF SAYI3
	INCF SAYI2,F
	RETURN	
BUYUK2
	MOVWF SAYI2
	INCF SAYI1,F
	RETURN
;
KODLA
	ADDWF PCL,F
	RETLW H'3F'
	RETLW H'06'
	RETLW H'5B'
	RETLW H'4F'
	RETLW H'66'
	RETLW H'6D'
	RETLW H'F6'
	RETLW H'07'
	RETLW H'FF'
	RETLW H'EF'			
GECIKDSP
NOP
NOP
DECFSZ GSAYAC,F
GOTO GECIKDSP

MOVLW D'250'
MOVWF GSAYAC1
GECIK1
NOP
NOP
DECFSZ GSAYAC1,F
GOTO GECIK1
CLRF GSAYAC
CLRF GSAYAC1
RETURN
END
