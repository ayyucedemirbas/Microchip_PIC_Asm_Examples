LIST P=16F877A
#INCLUDE <P16F877A.INC>
__CONFIG H'3F31'
YAZDEGER EQU 0X21
EPROMADRES EQU 0X22
BINLER EQU 0X23
YUZLER EQU 0X24
ONLAR EQU 0X25
BIRLER EQU 0X26
org 0x000
goto ANAPROGRAM
ORG 0X004
RETFIE
EPROMOKU
BSF STATUS,RP1
MOVLW H'05'
MOVWF EEADR
BSF STATUS,RP0
BCF EECON1,7
BSF EECON1,RD
BCF STATUS,RP0 ;BANK3
MOVF EEDATA,W
BCF STATUS,RP1 ;BANK0
MOVWF BINLER

BSF STATUS,RP1
MOVLW H'04'
MOVWF EEADR
BSF STATUS,RP0
BCF EECON1,7
BSF EECON1,RD
BCF STATUS,RP0 ;BANK3
MOVF EEDATA,W
BCF STATUS,RP1 ;BANK0
MOVWF YUZLER

BSF STATUS,RP1
MOVLW H'03'
MOVWF EEADR
BSF STATUS,RP0
BCF EECON1,7
BSF EECON1,RD
BCF STATUS,RP0 ;BANK3
MOVF EEDATA,W
BCF STATUS,RP1 ;BANK0
MOVWF ONLAR

BSF STATUS,RP1
MOVLW H'02'
MOVWF EEADR
BSF STATUS,RP0
BCF EECON1,7
BSF EECON1,RD
BCF STATUS,RP0 ;BANK3
MOVF EEDATA,W
BCF STATUS,RP1 ;BANK0
MOVWF BIRLER

RETURN


BASLANGIC
BSF STATUS,RP0 ;BANK1
MOVLW B'10000000'
MOVWF OPTION_REG
CLRF TRISA ;A PORTU ÇIKIÞA AYARLANDI
CLRF TRISD ;D PORTU ÇIKIÞA AYARLANDI
CALL EPROMOKU
BCF STATUS,RP0 ;BANK0
RETURN
ANAPROGRAM
CALL BASLANGIC

DONGU

MOVLW H'08'
MOVWF PORTA
MOVF BINLER,W
MOVWF PORTD
CLRF PORTD


MOVLW H'04'
MOVWF PORTA
MOVF YUZLER,W
MOVWF PORTD
CLRF PORTD

MOVLW H'02'
MOVWF PORTA
MOVF ONLAR,W
MOVWF PORTD
CLRF PORTD

MOVLW H'01'
MOVWF PORTA
MOVF BIRLER,W
MOVWF PORTD
CLRF PORTD

GOTO DONGU
END