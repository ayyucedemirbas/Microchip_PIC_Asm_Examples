LIST P=16F877A
#INCLUDE <P16F877A.INC>
__CONFIG H'3F31'
YAZDEGER EQU 0X21
EPROMADRES EQU 0X22
BINLER EQU 0X23
YUZLER EQU 0X24
ONLAR EQU 0X25
BIRLER EQU 0X26
RB0SAYAC EQU 0X27
RB0SAYAC2 EQU 0X28
org 0x000
goto ANAPROGRAM
ORG 0X004
BTFSS INTCON,0 ;RBCHANGE KESMESI GELDIMI
GOTO KESMESONU
BCF INTCON,7
BCF INTCON,0 ;KESMEYÝ KAPAT
BTFSC PORTB,4
GOTO BUTON1
BTFSC PORTB,5
GOTO BUTON2
BTFSC PORTB,6
GOTO BUTON3
BTFSC PORTB,7
GOTO BUTON4
GOTO DEVAM
BUTON1
MOVLW H'06';1
MOVWF YAZDEGER
CALL EPROMYAZ
GOTO DEVAM
BUTON2
MOVLW H'5B';2
MOVWF YAZDEGER
CALL EPROMYAZ
GOTO DEVAM
BUTON3
MOVLW H'4F' ;3
MOVWF YAZDEGER
CALL EPROMYAZ
GOTO DEVAM
BUTON4
MOVLW H'66' ;4
MOVWF YAZDEGER
CALL EPROMYAZ
GOTO DEVAM
DEVAM
CALL GECIKME
CLRF PORTB
BSF INTCON,7
KESMESONU
CALL EPROMOKU
RETFIE
EPROMOKU
BSF STATUS,RP1
BCF STATUS,RP0
MOVLW H'05'
MOVWF EEADR
BSF STATUS,RP0
BCF EECON1,7
BSF EECON1,RD
BCF STATUS,RP0 ;BANK3
MOVF EEDATA,W
BCF STATUS,RP1 ;BANK0
MOVWF BINLER

BSF STATUS,RP1
MOVLW H'04'
MOVWF EEADR
BSF STATUS,RP0
BCF EECON1,7
BSF EECON1,RD
BCF STATUS,RP0 ;BANK3
MOVF EEDATA,W
BCF STATUS,RP1 ;BANK0
MOVWF YUZLER

BSF STATUS,RP1
MOVLW H'03'
MOVWF EEADR
BSF STATUS,RP0
BCF EECON1,7
BSF EECON1,RD
BCF STATUS,RP0 ;BANK3
MOVF EEDATA,W
BCF STATUS,RP1 ;BANK0
MOVWF ONLAR

BSF STATUS,RP1
MOVLW H'02'
MOVWF EEADR
BSF STATUS,RP0
BCF EECON1,7
BSF EECON1,RD
BCF STATUS,RP0 ;BANK3
MOVF EEDATA,W
BCF STATUS,RP1 ;BANK0
MOVWF BIRLER

RETURN
EPROMYAZ ; YAZ.........................
DECFSZ EPROMADRES
GOTO DEVAM2
GOTO YAZMA
DEVAM2
MOVF EPROMADRES,W
BSF STATUS,RP1
MOVWF EEADR
BCF STATUS,RP1
MOVF YAZDEGER,W
BSF STATUS,RP1 ;BANK3
MOVWF EEDATA
BSF STATUS,RP0 ;BANK4
BCF EECON1,7
BSF EECON1,2
BCF INTCON,7 ;TÜM KESMELER ÝPTAL
MOVLW H'55'
MOVWF EECON2
MOVLW  H'AA'
MOVWF EECON2
BSF EECON1,1
YAZMABEKLE
BTFSC EECON1,1
GOTO YAZMABEKLE
BCF EECON1,2
YAZMA
CLRF STATUS ;BANK0 ADRESÝ VE CARRY=0

RETURN

GECIKME
DON1
MOVLW h'FF'
MOVWF RB0SAYAC2
DON2
DECFSZ RB0SAYAC2
GOTO DON2
DECFSZ RB0SAYAC
GOTO DON1
RETURN

MOVLW H'FF'
MOVWF RB0SAYAC
MOVWF RB0SAYAC2
RETURN
BASLANGIC
MOVLW B'11001000' ; GLOBAL VE ÇEVRESEL VE RBCHANGE KESMESINE IZIN VERME
MOVWF INTCON
MOVLW H'06'
MOVWF EPROMADRES
MOVWF YAZDEGER
BSF STATUS,RP0 ;BANK1
MOVLW B'10000000'
MOVWF OPTION_REG
CLRF TRISA ;A PORTU ÇIKIÞA AYARLANDI
CLRF TRISD ;D PORTU ÇIKIÞA AYARLANDI
MOVLW H'FF'
MOVWF TRISB ;B INPUTA AYARLANDI
CALL EPROMOKU
BCF STATUS,RP0 ;BANK0
MOVLW H'FF'
MOVWF PORTB
MOVWF RB0SAYAC
MOVWF RB0SAYAC2
RETURN


ANAPROGRAM
CALL BASLANGIC

DONGU


MOVLW H'08'
MOVWF PORTA
MOVF BINLER,W
MOVWF PORTD
CLRF PORTD


MOVLW H'04'
MOVWF PORTA
MOVF YUZLER,W
MOVWF PORTD
CLRF PORTD

MOVLW H'02'
MOVWF PORTA
MOVF ONLAR,W
MOVWF PORTD
CLRF PORTD

MOVLW H'01'
MOVWF PORTA
MOVF BIRLER,W
MOVWF PORTD
CLRF PORTD

GOTO DONGU
END