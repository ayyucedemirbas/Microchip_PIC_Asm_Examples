list P=16f877A
#include<P16F877A.inc>
SAYAC7 EQU 0x20
SAYAC6 EQU 0x21
SAYAC5 EQU 0x22
SAYAC4 EQU 0x23 
TMPWORK EQU 0x25
ORG 0x00
GOTO ana_program
ORG 0x04
KESME
MOVWF TMPWORK
BTFSS INTCON,0
GOTO KESME_BITIR
BTFSS PORTB,7
GOTO Y_ISLEM
BTFSS PORTB,6
GOTO A_ISLEM
BTFSS PORTB,5
GOTO B_ISLEM
BTFSS PORTB,4
GOTO D_ISLEM
GOTO KESME_BITIR

D_ISLEM
INCF SAYAC4,1
MOVLW D'10'
SUBWF SAYAC4,W
BTFSC STATUS,Z
CLRF SAYAC4
GOTO KESME_BITIR

B_ISLEM
INCF SAYAC5,1
MOVLW D'10'
SUBWF SAYAC5,W
BTFSC STATUS,Z
CLRF SAYAC5
GOTO KESME_BITIR

A_ISLEM
INCF SAYAC6,1
MOVLW D'10'
SUBWF SAYAC6,W
BTFSC STATUS,Z
CLRF SAYAC6
GOTO KESME_BITIR

Y_ISLEM
INCF SAYAC7,1
MOVLW D'10'
SUBWF SAYAC7,W
BTFSC STATUS,Z
CLRF SAYAC7
GOTO KESME_BITIR

KESME_BITIR
BCF INTCON,0
MOVF TMPWORK,0
retfie



LOOK
ADDWF PCL,F
RETLW 0x3F
RETLW 0x06
RETLW 0x5B
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RETLW 0x6F

ana_program
CLRF SAYAC7
CLRF SAYAC6
CLRF SAYAC5
CLRF SAYAC4
CLRF PORTD
CLRF PORTB
BSF STATUS,RP0
MOVLW H'00'
MOVWF TRISA
MOVLW H'00'
MOVWF OPTION_REG
CLRF TRISD
MOVLW H'F0'
MOVWF TRISB
BCF STATUS,RP0
MOVLW H'0F'
MOVWF PORTA
MOVLW H'FF'
MOVWF PORTB
MOVLW h'88'
MOVWF INTCON

DONGU

BCF PORTA,0
MOVF SAYAC4,0
CALL LOOK
MOVWF PORTD
BSF PORTA,0

BCF PORTA,1
MOVF SAYAC5,0
CALL LOOK
MOVWF PORTD
BSF PORTA,1

BCF PORTA,2
MOVF SAYAC6,0
CALL LOOK
MOVWF PORTD
BSF PORTA,2

BCF PORTA,3
MOVF SAYAC7,0
CALL LOOK
MOVWF PORTD
BSF PORTA,3
GOTO DONGU
END


