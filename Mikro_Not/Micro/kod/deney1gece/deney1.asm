list p=16f877a
#include <p16f877a.inc>
SAYAC EQU 0x25
SAYAC1 EQU 0x26
SAYAC2 EQU 0x27
org 0x00
goto ANA
org 0x04
goto KESME
KESME:
RETFIE
ANA:
BANKSEL TRISA
MOVLW H'FF'
MOVWF TRISA
BANKSEL PORTA
CLRF PORTA
BANKSEL TRISD
MOVLW H'00'
MOVWF TRISD
BANKSEL PORTD
CLRF PORTD
BANKSEL ADCON1
MOVLW B'00000110'
MOVWF ADCON1
BANKSEL SAYAC
CLRF SAYAC
CLRF SAYAC1
CLRF SAYAC2



DONGU:
BTFSS PORTA,0
GOTO ARTIR
BTFSS PORTA,1
GOTO AZALT
GOTO DONGU
ARTIR:

CALL GECIK
INCF PORTD
CALL GECIK
CLRF PORTA
GOTO DONGU
AZALT:
CALL GECIK
DECF PORTD
CALL GECIK
CLRF PORTA
GOTO DONGU

GECIK:
NOP
NOP
MOVLW H'FF'
MOVWF SAYAC1
DON:
NOP
NOP
MOVLW H'FF'
MOVWF SAYAC2
DON2:
DECFSZ SAYAC2,F
GOTO  DON2
DECFSZ SAYAC1,F
GOTO DON
RETURN
END