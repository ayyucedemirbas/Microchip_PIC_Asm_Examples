list p=16f877a
#include <p16f877a.inc>
KONTROL EQU 0X23
EN_FAZLA EQU 0x24

ORG 0
GOTO ANA
ORG 4
GOTO KESME
KESME:
BCF INTCON,0
BTFSS PORTB,4
GOTO ARTIR
BTFSS PORTB,5
GOTO AZALT
RETFIE

ARTIR:
BANKSEL EN_FAZLA
MOVLW H'FA'
MOVWF EN_FAZLA
BANKSEL CCPR1L
MOVF CCPR1L,0
SUBWF EN_FAZLA,1
BTFSS STATUS,2
GOTO ART
BANKSEL CCPR1L
CLRF CCPR1L
RETFIE
ART:
BANKSEL KONTROL
MOVF KONTROL,0
BANKSEL CCPR1L
ADDWF CCPR1L,1
RETFIE


AZALT:
BANKSEL CCPR1L
BTFSC CCPR1L,5
GOTO AZ
BTFSC CCPR1L,4
GOTO AZ
BANKSEL KONTROL
MOVF KONTROL,0
BANKSEL CCPR1L
ADDWF CCPR1L,1
RETFIE
AZ:
BANKSEL KONTROL
MOVF KONTROL,0
BANKSEL CCPR1L
SUBWF CCPR1L,1

RETFIE

ANA:
BANKSEL TRISB
MOVLW H'FF'
MOVWF TRISB
BANKSEL PORTB 
CLRF PORTB
BANKSEL TRISC
CLRF TRISC
BANKSEL PORTC
CLRF PORTC

BANKSEL INTCON
MOVLW H'C8'
MOVWF INTCON
BSF OPTION_REG,7

BANKSEL T2CON
MOVLW H'05'; PRESCLAR=4 YAPTIM BÝRDE TÝMER2 KULLANILABÝLÝR
MOVWF T2CON
BANKSEL PR2;249 SAYISI ATILDI
MOVLW D'249'
MOVWF PR2
BANKSEL CCP1CON
MOVLW B'00001100'; PWM MODU SEÇÝLDÝ VE CCPX CCPY DEÐERLERÝ ATILDI
MOVWF CCP1CON
BANKSEL CCPR1L
MOVLW H'7D'
MOVWF CCPR1L
BANKSEL KONTROL 
MOVLW H'19'
MOVWF KONTROL 



DONGU
GOTO DONGU 
END