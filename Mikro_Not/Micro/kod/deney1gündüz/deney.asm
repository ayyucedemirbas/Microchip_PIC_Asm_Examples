list p=16f877a
#include <p16f877a.inc>

SAYAC1 EQU 0x26; GECÝKME ÝÇÝN
SAYAC2 EQU 0x27; GECÝKME ÝÇÝN
org 0; BAÞLANGIÇ VEKTÖRÜ RESET
goto ANA
org 4; KESME VEKTÖRÜ
goto KESME
KESME:
RETFIE
ANA:
BANKSEL TRISA; TRISA NIN OLDUÐU BANKA GÝT
MOVLW H'FF'; WORKÝNGE FFATTIK
MOVWF TRISA; GÝRÝÞ YAPTIK HEPSÝNÝ
BANKSEL PORTA; PORTA NIN OLDUÐU BANKA GÝT
CLRF PORTA; PORTA ÝÇÝNÝ TEMÝZLE
BANKSEL TRISD; LED DEMÝÞ ÇIKIÞ YAPMAMIZ GEREKÝR ONDAN ÇIKIÞ YAPTIK
MOVLW H'00'; ÇIKIÞ YAPTIK TRISD YE SIFIR ATARAK
MOVWF TRISD
BANKSEL PORTD
CLRF PORTD
BANKSEL ADCON1
MOVLW B'00000110';DÝJÝTAL OLDUÐU ÝÇÝN
MOVWF ADCON1
BANKSEL PORTD
MOVLW h'04'
MOVWF PORTD
CLRF SAYAC1
CLRF SAYAC2
DONGU:
BTFSS PORTA,0;
GOTO SAG
BTFSS PORTA,1
GOTO SOL
GOTO DONGU
SOL:
RLF PORTD; PORTD NÝN ÝÇERÐÝNÝ BÝ BÝRÝM SOLA KAYDIRIR
CALL GECIK 
CALL GECIK
CLRF PORTA
GOTO DONGU
SAG:
RRF PORTD
CALL GECIK
CALL GECIK
CLRF PORTA
GOTO DONGU

GECIK:
MOVLW H'FF'
MOVWF SAYAC1; SAYAC1 ÝN ÝÇERÐÝNE 255 ATTIM
DON:
MOVLW H'FF'
MOVWF SAYAC2;255 ATTIK SAYAC2 YE
DON2:
DECFSZ SAYAC2,F
GOTO  DON2
DECFSZ SAYAC1,F
GOTO DON
RETURN
END
