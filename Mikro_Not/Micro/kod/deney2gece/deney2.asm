list p=16F877A
include <p16f877A.inc>
TMR0SAYAC EQU 21H ;sayacýn kaç kere azaltýlýcaðý
TMR1SAYAC EQU 22H ;sayacýn kaç kere azaltýlýcaðý
ORG 00H 
GOTO START
ORG 04H
GOTO KESME

KESME
BANKSEL INTCON
BTFSS INTCON,TMR0IF ;kesme timer0'den mi gelmiþ?
goto Blabel
goto TIMER0ISLEM ;kesme timer0'den gelmiþse buraya git
Blabel
BANKSEL PIR1 
BTFSS PIR1,TMR2IF ;kesme timer1'den mi gelmiþ?
RETFIE
goto TIMER1ISLEM;kesme timer1'den gelmiþse buraya git



TIMER0ISLEM
BANKSEL INTCON
BCF INTCON,TMR0IF
BANKSEL TMR0
MOVLW D'06'
MOVWF TMR0
DECFSZ TMR0SAYAC,F
goto DONGU
GOTO LED1

LED1
BANKSEL TMR0SAYAC
MOVLW D'10'
MOVWF TMR0SAYAC
BTFSS PORTD,0
GOTO LED1YAK
BTFSS PORTD,0
GOTO LED1SON

LED1YAK:
BSF PORTD,0
goto DONGU

LED1SON:
BCF PORTD,0
goto DONGU


TIMER1ISLEM
BANKSEL PIR1
BTFSS PIR1,TMR2IF
MOVLW d'06'
MOVWF TMR1L
BANKSEL TMR1H
MOVLW d'06'
MOVWF TMR1H
DECFSZ TMR1SAYAC,F
RETFIE
GOTO DONGU

LED2
BTFSS PORTD,1
GOTO YAK1
BCF PORTD,1
BANKSEL TMR1SAYAC
MOVLW D'4'
MOVWF TMR1SAYAC
RETFIE
YAK1:
BSF PORTD,1
BANKSEL TMR1SAYAC
MOVLW D'4'
MOVWF TMR1SAYAC
RETFIE
goto DONGU

START
BANKSEL PORTD 
CLRF PORTD ;PortD temizlenir
BANKSEL TRISD
MOVLW B'00000000'
MOVWF TRISD ;portd çýkýþ yapýlýr
BANKSEL OPTION_REG
MOVLW B'00000011'
MOVWF OPTION_REG ;tmr oran 1*16
BANKSEL INTCON
MOVLW B'11100000' 
MOVWF INTCON;kesme iþlemlerini aktif hale getir, çevre arabirimlerini aktif et, tmr0IE ile kesme bitine izin ver
BANKSEL PIE1
BSF PIE1,0 ;timer1'i kesmesini aktif hale getir
BANKSEL T1CON
MOVLW B'00010001'
MOVWF T1CON
BANKSEL TMR0
MOVLW D'06'
MOVWF TMR0
BANKSEL TMR1L
MOVLW d'06'
MOVWF TMR1L
BANKSEL TMR1H
MOVLW d'06'
MOVWF TMR1H
BANKSEL TMR0SAYAC
MOVLW D'10'
MOVWF TMR0SAYAC
BANKSEL TMR1SAYAC
MOVLW D'4'
MOVWF TMR1SAYAC
DONGU 
GOTO DONGU
END