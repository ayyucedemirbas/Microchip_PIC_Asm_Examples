list p=16f877a
#include <p16f877a.inc>
TMR0SAYAC EQU 0x24
TMR1SAYAC EQU 0x25 
org 0
goto ana
org 4
goto kesme
kesme:
BTFSS INTCON,2
GOTO KONTROL1
BCF INTCON,2
BANKSEL TMR0
MOVLW D'6'
MOVWF TMR0
DECFSZ  TMR0SAYAC,F
RETFIE
BTFSS PORTD,0
GOTO YAK0
BCF PORTD,0
BANKSEL TMR0SAYAC
MOVLW D'200'
MOVWF TMR0SAYAC
RETFIE
YAK0:
BSF PORTD,0
BANKSEL TMR0SAYAC
MOVLW D'200'
MOVWF TMR0SAYAC
RETFIE

KONTROL1:
BTFSS PIR1,0
RETFIE
BCF PIR1,0
BANKSEL TMR1L
MOVLW H'B0'
MOVWF TMR1L
BANKSEL TMR1H
MOVLW H'3C'
MOVWF TMR1H
DECFSZ TMR1SAYAC,1
RETFIE
BTFSS PORTD,1
GOTO YAK1
BCF PORTD,1
BANKSEL TMR1SAYAC
MOVLW D'10'
MOVWF TMR1SAYAC
RETFIE
YAK1:
BSF PORTD,1
BANKSEL TMR1SAYAC
MOVLW D'10'
MOVWF TMR1SAYAC
RETFIE


ana:
BANKSEL TRISD
CLRF TRISD
BANKSEL PORTD
CLRF PORTD
BANKSEL OPTION_REG
MOVLW H'03'
MOVWF OPTION_REG
BANKSEL INTCON
MOVLW B'11100000'
MOVWF INTCON
BANKSEL TMR0
MOVLW D'06'
MOVWF TMR0
BANKSEL PIE1
MOVLW H'01'
MOVWF PIE1
BANKSEL T1CON
MOVLW H'41'
MOVWF T1CON
BANKSEL TMR1L
MOVLW H'B0'
MOVWF TMR1L
BANKSEL TMR1H
MOVLW H'3C'
MOVWF TMR1H
BANKSEL TMR0SAYAC
MOVLW D'200'
MOVWF TMR0SAYAC
BANKSEL TMR1SAYAC
MOVLW D'10'
MOVWF TMR1SAYAC                                     
DONGU
GOTO DONGU
END
