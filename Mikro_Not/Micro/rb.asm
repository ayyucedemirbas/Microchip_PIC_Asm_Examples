list p=16f877a
#INCLUDE <P16F877A.INC>
SAYAC1 EQU 0x23
SAYAC2 EQU 0x24
SAYAC EQU 0x25
SAYAC4 EQU 0x26

ORG 0
GOTO ANA
ORG 4
GOTO KESME
KESME:
BTFSS INTCON,0
RETFIE
BCF INTCON,0
BTFSS PORTB,4
GOTO YAZ23
BTFSS PORTB,5
GOTO YAZ40
RETFIE
YAZ23:

BCF INTCON,0
BANKSEL SAYAC
MOVLW D'0'; TABLODA 0.  DEÐER 3
MOVWF SAYAC
BANKSEL SAYAC
MOVLW D'1' ; TABLODA 1. DEÐER 2
MOVWF SAYAC4
RETFIE
YAZ40:

BCF INTCON,0
BANKSEL SAYAC
MOVLW D'2' ; TABLODA 2. DEGER 0
MOVWF SAYAC
BANKSEL SAYAC
MOVLW D'3' ;TABLODA 3. DEGER 4
MOVWF SAYAC4
RETFIE

; ÞÝMDÝ KESMEDEN ÇIKNCA YENÝ DEÐER ALACAK SAYAÇLAR GÝDÝP TBLODAN ALIP GÖNDERECK DÝSPLYA



TABLO:
ADDWF PCL,F; 4 DEÐER ATTIM 
RETLW H'4F';3
RETLW H'5B';2
RETLW  H'3F';0
RETLW  H'66';4




ANA:
BANKSEL TRISA
CLRF TRISA
BANKSEL PORTA
MOVLW H'00'
MOVWF PORTA
BANKSEL TRISB
MOVLW H'FF';RBCHNGE BUTTON
MOVWF TRISB
BANKSEL PORTB
CLRF PORTB
BANKSEL TRISD
CLRF TRISD
BANKSEL PORTD
CLRF PORTD

BANKSEL INTCON
MOVLW B'11001000'
MOVWF INTCON
BANKSEL OPTION_REG
MOVLW H'00'
MOVWF OPTION_REG

BANKSEL SAYAC1
CLRF SAYAC1
CLRF SAYAC2
MOVLW D'6';0 1 2 3 DEN FKRKLI DEÐER ATIYORUM ÇNKÜ TABLODAN GÝDÝP VERÝ GETÝRMESÝN 
MOVWF SAYAC4
MOVWF SAYAC

DONGU:
BANKSEL PORTA
MOVLW H'01'
MOVWF PORTA
BANKSEL SAYAC
MOVF SAYAC,0
CALL TABLO
BANKSEL PORTD
MOVWF PORTD
MOVWF PORTD

CLRF PORTD

BANKSEL PORTA
MOVLW H'02'
MOVWF PORTA
BANKSEL SAYAC4
MOVF SAYAC4,0
CALL TABLO
BANKSEL PORTD
MOVWF PORTD
MOVWF PORTD

CLRF PORTD
GOTO DONGU 

END
