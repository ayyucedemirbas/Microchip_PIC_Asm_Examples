list p=16f877a
#include <p16f877A.inc>
SAYAC EQU 0X23
SAYAC1 EQU 0x24
SAYAC2 EQU 0x25
LCD_VERI EQU 0x26
VERI EQU 0x27

ORG 0
GOTO ANA
ORG 4
GOTO KESME
KESME:
RETFIE
ANA:
BANKSEL TRISB
CLRF TRISB
BANKSEL PORTB
CLRF PORTB
CALL LCD_HAZIRLA
BANKSEL SAYAC
CLRF SAYAC
DON2:
MOVLW H'06'
CALL KOMUT_YAZ
MOVF SAYAC,0
CALL TABLO 
MOVWF VERI
MOVF VERI,0
CALL KARAKTER_YAZ
INCF SAYAC,F
MOVLW D'4'
SUBWF SAYAC,0
BTFSC STATUS,Z
GOTO	DON3
GOTO	DON2
DON3:
CALL	IKINCI_SATIR
DON4:
MOVLW H'06'
CALL KOMUT_YAZ
MOVF SAYAC,0
CALL TABLO 
MOVWF VERI
MOVF VERI,0
CALL KARAKTER_YAZ
INCF SAYAC,F
MOVLW D'9'
SUBWF SAYAC,0
BTFSC STATUS,Z
GOTO	DONGU
GOTO DON4

DONGU
	GOTO	DONGU






LCD_HAZIRLA:
MOVLW H'02'
CALL KOMUT_YAZ
MOVLW H'0E'
CALL KOMUT_YAZ
MOVLW H'01'
CALL KOMUT_YAZ
MOVLW H'28'
CALL KOMUT_YAZ

RETURN
TABLO:
ADDWF PCL,F
RETLW 'T'
RETLW 'U'
RETLW 'B'
RETLW 'A'
RETLW 'C'
RETLW 'E'
RETLW 'L'
RETLW 'I'
RETLW 'K'


IKINCI_SATIR:
MOVLW H'C0'
CALL KOMUT_YAZ
RETURN
KOMUT_YAZ:
MOVWF LCD_VERI
SWAPF LCD_VERI,0
CALL KOMUT_GONDER
MOVF LCD_VERI,0
CALL KOMUT_GONDER
RETURN
KOMUT_GONDER:
ANDLW H'0F'
MOVWF PORTB
BCF PORTB,4
BSF PORTB,5

BCF PORTB,5
CALL GECIK
RETURN
KARAKTER_YAZ:
MOVWF LCD_VERI
SWAPF LCD_VERI,0
CALL KARAKTER_GONDER
MOVF LCD_VERI,0
CALL KARAKTER_GONDER
RETURN

KARAKTER_GONDER:
ANDLW H'0F'
MOVWF PORTB
BSF PORTB,4
BSF PORTB,5

BCF PORTB,5
CALL GECIK
RETURN


GECIK:
MOVLW H'FF'
MOVWF SAYAC1
DON:
MOVLW H'FF'
MOVWF SAYAC2
DON1:
DECFSZ SAYAC2,F
GOTO DON1
DECFSZ SAYAC1,F
GOTO DON
RETURN
end