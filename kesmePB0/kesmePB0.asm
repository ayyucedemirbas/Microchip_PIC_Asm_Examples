	LIST P=16F877A
	#INCLUDE <P16F877A.INC>
	DEGER EQU 0X20
	DEGER2 EQU 0X21
	ORG 0X00
	CALL INIT
	GOTO MAIN
	ORG 0X04
	GOTO KESME
INIT 
	BANKSEL INTCON
	BCF INTCON,INTF
	BSF INTCON,INTE
	BSF INTCON,PEIE
	BSF INTCON,GIE
	
	BANKSEL TRISB
	MOVLW 0XFF
	MOVWF TRISB
	CLRF TRISC
	CLRF PORTD
	
	BANKSEL PORTB
	CLRF PORTB
	CLRF PORTC
	CLRF PORTD
RETURN
MAIN
	NOP
	INCF PORTD,1
	CALL GECIKME
	GOTO MAIN
KESME
	BCF INTCON,GIE
	BTFSS PORTC,0
	GOTO YAK
	GOTO SONDUR
YAK
	BSF PORTC,0
	GOTO DEVAM
SONDUR
	BCF PORTC,0
	GOTO DEVAM

DEVAM
	BCF INTCON,INTF
	BSF INTCON,GIE
RETURN

GECIKME
	MOVLW 0XFF
	MOVWF DEGER
DONGU
	MOVLW 0XFF
	MOVWF DEGER2
DONGU2
	DECFSZ DEGER2,1
	GOTO DONGU2
	DECFSZ DEGER,1
	GOTO DONGU
	RETURN
END
	
	
		

	